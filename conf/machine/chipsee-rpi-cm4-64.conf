## conf/machine/chipsee-rpi-cm4-64.conf
```bitbake
require conf/machine/raspberrypi4-64.conf

MACHINE_ESSENTIAL_EXTRA_RRECOMMENDS += "kernel-modules"

CHIPSEE_KERNEL_DEVICETREE ?= " \
    cs-i2c0-overlay.dtb \
    gt9xx-overlay.dtb \
    pwm-backlight-overlay.dtb \
"

KERNEL_DEVICETREE:append += " \
    broadcom/bcm2711-rpi-400.dtb \
    broadcom/bcm2711-rpi-cm4.dtb \
    ${CHIPSEE_KERNEL_DEVICETREE} \
"

SDIMG_KERNELIMAGE = "kernel8.img"
SERIAL_CONSOLES = "115200;ttyS0"

KERNEL_MODULE_AUTOLOAD:rpi += "i2c-dev"
ENABLE_I2C = "1"
ENABLE_UART = "1"

RPI_EXTRA_CONFIG = " \n \
# Enable audio (loads snd_bcm2835) \n \
dtparam=audio=on \n \
# Audio \n \
gpio=6=op,dh \n \
# I2C \n \
dtoverlay=i2c0,pins_44_45 \n \
# RTC \n \
dtoverlay=i2c-rtc,ds1307,addr=0x32 \n \
# UART \n \
dtoverlay=miniuart-bt \n \
enable_uart=1 \n \
core_freq=250 \n \
dtoverlay=uart2 \n \
dtoverlay=uart3 \n \
dtoverlay=uart5 \n \
# LED \n \
dtparam=act_led_trigger=heartbeat \n \
# SD1 \n \
dtoverlay=sdio,poll_once=off \n \
# Touch \n \
dtoverlay=gt9xx,interrupt=20,reset=21 \n \
##GPIO \n \
gpio=18=op,dh \n \
dtoverlay=pwm-backlight,pin=18,func=2,pwm_0 \n \
# Follow Can fix some hardware issue \n \
hdmi_force_hotplug=1 \n \
hdmi_group=2 \n \
hdmi_drive=2 \n \
hdmi_mode=87 \n \
hdmi_timings=1024 0 160 10 160 600 0 12 1 23 0 0 0 60 0 52000000 6 \n \
hdmi_ignore_edid=0xa5000080 \n \
hdmi_pixel_encoding=1 \n \
# MCP23008 \n \
dtoverlay=mcp23017,mcp23008,addr=0x20,noints \n \
# MCP2517 \n \
dtoverlay=mcp2515-can0,oscillator=8000000,interrupt=16 \n \
# USB \n \
dtoverlay=dwc2,dr_mode=host \n \
"
```
